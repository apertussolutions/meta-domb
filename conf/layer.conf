## conf/layer.conf
```bitbake
# We have a conf directory, append to BBPATH
BBPATH .= ":${LAYERDIR}"

# We have a recipes directory, add to BBFILES
BBFILES += "${LAYERDIR}/recipes*/*/*.bb ${LAYERDIR}/recipes*/*/*.bbappend"

BBFILE_COLLECTIONS += "domb-layer"
BBFILE_PATTERN_domb-layer := "^${LAYERDIR}/"
BBFILE_PRIORITY_domb-layer = "8"

# This should only be incremented on significant changes that will
# cause compatibility issues with other layers
LAYERVERSION_domb-layer = "1"
LAYERSERIES_COMPAT_domb-layer = "thud warrior zeus"
LAYERDEPENDS_domb-layer = " \
    core \
    virtualization-layer \
"
```
